## dts/bindings/usb/raspberrypi,pio-usb-host.yaml
```yaml
# Copyright (c) 2026 The Cosmos-Keyboards Contributors
# SPDX-License-Identifier: MIT

description: |
  Pico-PIO-USB host controller. Bit-banged USB Full-Speed host on an RP2040
  PIO state machine, exposed as a Zephyr UHC.

  Phase 2 scaffold: the underlying driver is currently a stub that returns
  -ENOSYS for all operations. The binding is published now so devicetrees
  can reference it during integration work.

compatible: "raspberrypi,pio-usb-host"

include: base.yaml

properties:
  pin-dp:
    type: int
    required: true
    description: |
      RP2040 GPIO number of the D+ pin. D- must be on the adjacent GPIO —
      either DP+1 or DP-1, selected by the `pinout` property. Pico-PIO-USB
      drives both pins directly; do not configure them via pinctrl.

  pinout:
    type: string
    enum:
      - "dpdm"
      - "dmdp"
    default: "dpdm"
    description: |
      Order of the D+/D- pin pair. "dpdm" means D- = DP + 1 (the common
      case for USB-C dongles). "dmdp" means D- = DP - 1.

  pio:
    type: phandle
    description: |
      PIO instance the host state machine programs run on. Optional —
      Pico-PIO-USB hardcodes PIO0 today; this property is reserved for
      future multi-PIO support and is currently informational only.

  data-rate:
    type: string
    enum:
      - "full-speed"
      - "low-speed"
    default: "full-speed"
    description: USB bus speed. Full-speed is the only well-tested mode.

  pinctrl-0:
    description: |
      Optional pinctrl group. Pico-PIO-USB configures the D+/D- pins
      itself; this property is provided for boards that want to reserve
      the pins through the pinctrl framework. Most boards omit it.

  pinctrl-names:
    description: Required when pinctrl-0 is set.
```

## zephyr/Kconfig
```kconfig
# Copyright (c) 2026 The Cosmos-Keyboards Contributors
# SPDX-License-Identifier: MIT

menuconfig UHC_PIO_USB
	bool "Pico-PIO-USB host controller"
	depends on SOC_RP2040 && UHC_DRIVER
	select PICOSDK_USE_PIO
	select PICOSDK_USE_DMA
	select PICOSDK_USE_GPIO
	select PICOSDK_USE_TIMER
	select PICOSDK_USE_CLAIM
	help
	  Enable the Zephyr UHC driver that wraps sekigon-gonnoc/Pico-PIO-USB
	  in host mode. Owns PIO0 and consumes a D+/D- GPIO pair via the
	  raspberrypi,pio-usb-host devicetree binding.

if UHC_PIO_USB

config UHC_PIO_USB_THREAD_STACK_SIZE
	int "uhc_pio_usb driver thread stack size"
	default 2048

config UHC_PIO_USB_THREAD_PRIORITY
	int "uhc_pio_usb driver thread priority"
	default 8
	help
	  Cooperative-priority driver thread that polls Pico-PIO-USB endpoint
	  completion bitmaps and routes results back through the Zephyr UHC
	  event API. Should run above most application threads but below
	  time-critical kernel work.

endif # UHC_PIO_USB

menuconfig UDC_PIO_USB
	bool "Pico-PIO-USB device controller"
	depends on SOC_RP2040 && UDC_DRIVER
	select PICOSDK_USE_PIO
	select PICOSDK_USE_DMA
	select PICOSDK_USE_GPIO
	select PICOSDK_USE_TIMER
	select PICOSDK_USE_CLAIM
	help
	  Enable the Zephyr UDC driver that wraps sekigon-gonnoc/Pico-PIO-USB
	  in device mode. Owns PIO0 and consumes a D+/D- GPIO pair via the
	  raspberrypi,pio-usb-device devicetree binding. Mutually exclusive
	  with UHC_PIO_USB at build time (one PIO instance, one program).

if UDC_PIO_USB

config UDC_PIO_USB_THREAD_STACK_SIZE
	int "udc_pio_usb driver thread stack size"
	default 2048

config UDC_PIO_USB_THREAD_PRIORITY
	int "udc_pio_usb driver thread priority"
	default 8

endif # UDC_PIO_USB
```
