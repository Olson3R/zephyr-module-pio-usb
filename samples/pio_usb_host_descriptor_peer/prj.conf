## CMakeLists.txt
```
# SPDX-License-Identifier: MIT

cmake_minimum_required(VERSION 3.20.0)
find_package(Zephyr REQUIRED HINTS $ENV{ZEPHYR_BASE})
project(pio_usb_host_descriptor_peer)

target_sources(app PRIVATE src/main.c)
```

## sample.yaml
```
sample:
  name: Pico-PIO-USB UHC descriptor-dump test peer
  description: |
    Native-USB CDC ACM device with a fixed VID/PID/strings, intended as
    the device-side companion to samples/pio_usb_host_descriptor. Flash
    this on a second board, connect its native USB-C to the host's Link
    USB-C, and the host's descriptor dump should match the "Expected
    output" block in pio_usb_host_descriptor/README.md exactly.
tests:
  sample.zephyr-module-pio-usb.host_descriptor_peer:
    platform_allow: cosmos_lemon_wired rpi_pico
    tags: usb pio
```

## prj.conf
```kconfig
# SPDX-License-Identifier: MIT
#
# Pico-PIO-USB host descriptor-dump sample's deterministic test peer.
# Stand-up a Zephyr USB device on the native USB block with a fixed
# VID / PID / manufacturer / product / serial-number string set so the
# host-side `pio_usb_host_descriptor` sample's "Expected output" block
# is reproducible — flash this on a second board, plug its native USB-C
# into the host's Link USB-C, watch the descriptor dump match exactly.
#
# This is intentionally minimal: just the legacy USB device stack with
# CDC ACM as the (unused) interface so the device has at least one
# class to enumerate. No data flows in either direction at runtime;
# this peer exists to expose a stable device descriptor and that's it.

CONFIG_MAIN_STACK_SIZE=1024

CONFIG_LOG=n

# Legacy USB device stack on the native USB block (zephyr_udc0). Init
# at boot so the device responds to the host's first SETUP without
# waiting for application code. Single CDC ACM interface keeps the
# enumeration trivial — the host's `pio_usb_host_descriptor` only
# walks the device descriptor, so the configuration descriptor's
# contents don't matter much; CDC ACM just gives us *some* class.
CONFIG_USB_DEVICE_STACK=y
CONFIG_USB_DEVICE_INITIALIZE_AT_BOOT=y
CONFIG_USB_DEVICE_VID=0x2fe3
CONFIG_USB_DEVICE_PID=0x42aa
CONFIG_USB_DEVICE_MANUFACTURER="zephyr-pio-usb"
CONFIG_USB_DEVICE_PRODUCT="PIO-USB descriptor host test peer"
CONFIG_USB_DEVICE_SN="DESCTEST"

CONFIG_SERIAL=y
CONFIG_USB_CDC_ACM=y
CONFIG_UART_INTERRUPT_DRIVEN=y

# This board family ships with broken in-tree flash drivers we don't
# need anyway. Match what the rest of the samples and the rainadon-zmk
# Lemon Wired confs do to avoid build failures on the FLASH/NVS path.
CONFIG_FLASH=n
CONFIG_NVS=n
CONFIG_SETTINGS=n
```

## boards/cosmos_lemon_wired.overlay
```dts
/*
 * SPDX-License-Identifier: MIT
 *
 * Lemon Wired overlay for the descriptor-dump test peer. The native
 * USB-C port (the RP2040's hardware USB block) carries the CDC ACM
 * device the paired host enumerates. The Link USB-C port (GP0/GP1
 * PIO-USB) is unused on the peer — connect a cable from the host's
 * Link USB-C to *this board's native USB-C* for the host's enumeration
 * to see this peer.
 */

&zephyr_udc0 {
	status = "okay";
	cdc_acm_uart0: cdc_acm_uart0 {
		compatible = "zephyr,cdc-acm-uart";
	};
};
```

## boards/rpi_pico.overlay
```dts
/*
 * SPDX-License-Identifier: MIT
 *
 * Raspberry Pi Pico overlay for the descriptor-dump test peer. Native
 * USB-B (the Pico's hardware USB block) carries the CDC ACM device the
 * paired host enumerates. PIO-USB / Link wiring is not used here — the
 * peer is purely a USB device on the native port.
 */

&zephyr_udc0 {
	status = "okay";
	cdc_acm_uart0: cdc_acm_uart0 {
		compatible = "zephyr,cdc-acm-uart";
	};
};
```

## src/main.c
```c
/*
 * SPDX-License-Identifier: MIT
 *
 * Test peer for samples/pio_usb_host_descriptor. The legacy USB device
 * stack auto-initializes at boot (CONFIG_USB_DEVICE_INITIALIZE_AT_BOOT)
 * with the VID/PID/strings pinned in prj.conf; main itself has nothing
 * to do beyond keeping the kernel running so the USB device thread
 * stays scheduled.
 */

#include <zephyr/kernel.h>

int main(void)
{
	while (1) {
		k_sleep(K_FOREVER);
	}
	return 0;
}
```
